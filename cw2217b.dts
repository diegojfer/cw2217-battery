/dts-v1/;
/plugin/;

/ {
    compatible = "brcm,bcm2711", "brcm,bcm2712", "brcm,bcm2835";

    fragment@0 {
        target = <&i2c1>;
        __overlay__ {
            #address-cells = <1>;
            #size-cells = <0>;
            status = "okay";

            cw2217b: cw2217b@64 {
                reg = <0x64>;
                compatible = "cellwise,cw2217b";
            };
        };
    };
};
